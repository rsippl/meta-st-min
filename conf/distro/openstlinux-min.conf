## conf/distro/openstlinux-min.conf
```bitbake
#@NAME: openstlinux-min
#@DESCRIPTION: minimal, bare-bones OpenSTLinux (with GPLv3 software)

require conf/distro/include/st-default-distro-rules.inc
require conf/distro/include/st-default-distro-providers.inc
require conf/distro/include/openstlinux.inc

# =========================================================================
# Distribution definition
# =========================================================================
DISTRO = "openstlinux-min"
DISTRO_NAME = "ST OpenSTLinux - Minimal - (A Yocto Project Based Distro)"

# Warning: TARGET_VENDOR does not contains a valid OS/ARCH name like : linux, arm
# Warning: '-' are forbidden between each word of TARGET_VENDOR
TARGET_VENDOR = "-openstlinux_min"
# Warning: '-' are forbidden between each word of SDK_VENDOR
SDK_VENDOR = "-openstlinux_min_sdk"

# =========================================================================
# DISTRO features
# =========================================================================
#DISTRO_FEATURES_append = " myfeature "
DISTRO_FEATURES_remove = " alsa gstreamer splashscreen kde pulseaudio gobject-introspection-data wayland x11 "

DISTRO_FEATURES_append = " gplv3 "
```

## conf/layer.conf
```bitbake
# We have a conf and classes directory, add to BBPATH
BBPATH .= ":${LAYERDIR}"

# We have recipes-* directories, add to BBFILES
BBFILES += "${LAYERDIR}/recipes-*/*/*.bb \
            ${LAYERDIR}/recipes-*/*/*.bbappend"

BBFILE_COLLECTIONS += "meta-st-min"
BBFILE_PATTERN_meta-st-min = "^${LAYERDIR}/"
BBFILE_PRIORITY_meta-st-min = "7"

LAYERDEPENDS_meta-st-min = "core"
LAYERSERIES_COMPAT_meta-st-min = "thud"
```
